## dfrobot_esp32-c5/Kconfig
```kconfig
config HEAP_MEM_POOL_ADD_SIZE_BOARD
	int
	default 4096 if BOARD_DFROBOT_ESP32_C5_ESP32C5_HPCORE
	default 256 if BOARD_DFROBOT_ESP32_C5_ESP32C5_LPCORE
```

## dfrobot_esp32-c5/Kconfig.dfrobot_esp32-c5
```kconfig
config BOARD_DFROBOT_ESP32_C5
	select SOC_ESP32C5
	select SOC_ESP32C5_HPCORE if BOARD_DFROBOT_ESP32_C5_ESP32C5_HPCORE
	select SOC_ESP32C5_LPCORE if BOARD_DFROBOT_ESP32_C5_ESP32C5_LPCORE
```

## dfrobot_esp32-c5/board.yml
```yaml
board:
  name: dfrobot_esp32-c5
  full_name: DFRobot ESP32-C5 Firebeetle V2
  vendor: dfrobot
  socs:
  - name: esp32c5
```

## dfrobot_esp32_firebeetle/Kconfig
```kconfig
config HEAP_MEM_POOL_ADD_SIZE_BOARD
	int
	default 4096 if BOARD_DFROBOT_ESP32_FIREBEETLE_ESP32_PROCPU
	default 256 if BOARD_DFROBOT_ESP32_FIREBEETLE_ESP32_APPCPU
```

## dfrobot_esp32_firebeetle/Kconfig.dfrobot_esp32_firebeetle
```kconfig
config BOARD_DFROBOT_ESP32_FIREBEETLE
	select SOC_ESP32_WROOM_32UE_N8
	select SOC_ESP32_PROCPU if BOARD_DFROBOT_ESP32_FIREBEETLE_PROCPU
	select SOC_ESP32_APPCPU if BOARD_DFROBOT_ESP32_FIREBEETLE_APPCPU
```

## dfrobot_esp32_firebeetle/board.yml
```yaml
board:
  name: dfrobot_esp32_firebeetle
  full_name: DFRobot ESP32 Firebeetle
  vendor: other
  socs:
  - name: esp32
```

## esp32_gen_devkit/Kconfig.esp32_gen_devkit
```kconfig
config BOARD_ESP32_GEN_DEVKIT
	select SOC_ESP32_WROOM_32UE_N4
	select SOC_ESP32_PROCPU if BOARD_ESP32_GEN_DEVKIT_PROCPU
	select SOC_ESP32_APPCPU if BOARD_ESP32_GEN_DEVKIT_APPCPU
```

## esp32_gen_devkit/board.yml
```yaml
board:
  name: esp32_gen_devkit
  full_name: ESP32 Generic Devkit
  vendor: other
  socs:
  - name: esp32
```

## sparkfun_esp32_thing/Kconfig
```kconfig
config HEAP_MEM_POOL_ADD_SIZE_BOARD
	int
	default 4096 if BOARD_SPARKFUN_ESP32_THING_ESP32_PROCPU
	default 256 if BOARD_SPARKFUN_ESP32_THING_ESP32_APPCPU
```

## sparkfun_esp32_thing/Kconfig.sparkfun_esp32_thing
```kconfig
config BOARD_SPARKFUN_ESP32_THING
	select SOC_ESP32_WROOM_32UE_N4
	select SOC_ESP32_PROCPU if BOARD_SPARKFUN_ESP32_THING_PROCPU
	select SOC_ESP32_APPCPU if BOARD_SPARKFUN_ESP32_THING_APPCPU
```

## sparkfun_esp32_thing/board.yml
```yaml
board:
  name: sparkfun_esp32_thing
  full_name: Sparkfun ESP32 Thing Board
  vendor: sparkfun
  socs:
  - name: esp32
```
